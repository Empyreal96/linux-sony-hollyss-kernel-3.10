## drivers/misc/mediatek/nfc/Kconfig
```kconfig
menuconfig MTK_NFC
	tristate "NFC drivers"
	default y
	---help---
	  Say Y here for supporting NFC.

if MTK_NFC

config NFC_MT6605
	tristate "MediaTek NFC driver"
	default n

config NFC_MSR3110
	tristate "MSR3110 NFC driver"
	default n

config NFC_NXP_PN547
        tristate "NXP NFC PN547 driver"
        default y

endif # NFC
```
